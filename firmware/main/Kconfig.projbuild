## firmware/main/Kconfig.projbuild
```kconfig
menu "Little World startup"

    choice LW_BOOT_MODE
        prompt "Startup mode"
        default LW_BOOT_MODE_OS_V2
        help
            Selects which UI the firmware starts after board bring-up.
            OS V2 is the integrated desktop; Legacy keeps the pre-OS shell.

        config LW_BOOT_MODE_OS_V2
            bool "OS V2 desktop (lw_os_start)"
        config LW_BOOT_MODE_LEGACY
            bool "Legacy application shell (lw_ui_start)"
    endchoice

    config LW_ENABLE_AUDIO
        bool "Probe the ES8311 speaker path at boot"
        default y
        help
            Opens the BSP speaker codec so volume changes can reach the
            hardware. When the codec is absent the OS keeps the volume as a
            stored preference and the UI must not claim real audio output.

endmenu
menu "Little World connectivity"

    config LW_NET_WIFI_ENABLE
        bool "Enable the ESP32-C6 Wi-Fi backend"
        default n
        help
            Compile the real Wi-Fi adapter (lw_net_wifi_esp.c) and pull in
            esp_wifi. Requires the esp_hosted and esp_wifi_remote managed
            components and a working SDIO link to the C6. When disabled the
            firmware reports the radio as unsupported instead of pretending
            to scan.

    config LW_NET_SNTP_ENABLE
        bool "Enable SNTP time synchronisation"
        default n
        depends on LW_NET_WIFI_ENABLE
        help
            Synchronise the wall clock from pool.ntp.org once Wi-Fi is up.
            Without it the time service stays on the DEMO clock.

endmenu

menu "Little World diagnostics (build-time only)"

    # Backlight diagnostics for the panel-flicker comparison builds. The choice
    # is compile-time on purpose: a runtime switch would leave the LEDC timer
    # configured and make some of the runs indistinguishable.
    choice LW_BACKLIGHT_MODE
        prompt "Backlight control (diagnostic)"
        default LW_BACKLIGHT_RUNTIME

        config LW_BACKLIGHT_RUNTIME
            bool "Standard: LEDC duty follows the brightness slider"
            help
                The shipping behaviour: the BSP LEDC channel is rewritten every
                time the brightness preference changes.

        config LW_BACKLIGHT_FIXED
            bool "Fixed duty: write once at boot, never again"
            help
                Diagnostic B. The brightness slider becomes a stored preference
                that never reaches the LEDC channel. If the flicker stops, the
                runtime duty writes are the cause.

        config LW_BACKLIGHT_MINIMAL
            bool "Minimal load: fixed duty at 30%, no runtime writes"
            help
                Diagnostic C. Fixed duty at a low level, so the LCD boost and
                charge pump run at their smallest load.
    endchoice

    # V4.4 display benchmark: the tear-avoid mode is what decides how many
    # frame buffers the panel path rotates through and how a flush is handed to
    # the DPI peripheral. It used to be hard-coded to TRIPLE_PARTIAL in
    # app_main.c, which made "is the refresh path or the draw path the
    # bottleneck?" impossible to answer without editing source between builds.
    # The choice stays compile-time on purpose: a runtime switch would leave
    # frame buffers allocated and make two runs indistinguishable.
    choice LW_TEAR_AVOID
        prompt "Display tear-avoid mode (benchmark)"
        default LW_TEAR_AVOID_TRIPLE_PARTIAL

        config LW_TEAR_AVOID_TRIPLE_PARTIAL
            bool "Triple buffering, partial refresh (shipping default)"
            help
                Three frame buffers, LVGL flushes dirty areas only. This is the
                configuration every measurement in reports/perf-v4-4 was taken
                with before V4.4.

        config LW_TEAR_AVOID_DOUBLE_PARTIAL
            bool "Double buffering, partial refresh"
            help
                Two frame buffers instead of three. Fewer buffers means the
                flush must wait for the previous transfer to land sooner, but
                it also frees ~2.4 MB of PSRAM and shortens the rotation.

        config LW_TEAR_AVOID_TRIPLE_FULL
            bool "Triple buffering, full-frame refresh"
            help
                Every flush covers the whole 1024x600 frame. This is the upper
                bound of flush cost: if full-frame flushing is still fast, the
                panel path is not the bottleneck.
    endchoice

    config LW_DIAG_STATIC_UI
        bool "Diagnostic C: static UI, no animation or per-frame updates"
        default n
        help
            Freeze the desktop: the sprite frame clock never runs, actors stop
            moving, and the 20 ms OS tick stops refreshing labels. Used only to
            separate "the animation/render load flickers the panel" from "the
            display path itself flickers". Never ship a build with this on.

    config LW_DIAG_NO_MEDIUM
        bool "Diagnostic D: behave as if no TF card were inserted"
        default n
        help
            Skips the card mount entirely and takes the same code path a real
            missing card takes: embedded character pack, labelled scene
            fallback, no scene files. It exists so the no-card acceptance run
            can be done without physically removing the card, and so the
            fallback cannot rot unnoticed. Never ship a build with this on.

    config LW_DIAG_CONSOLE
        bool "Read-only diagnostics console commands (diag / diagjson / diagerr)"
        default y
        help
            Registers the read-only diagnostics commands on the UART0 console.
            They only read state: no command here writes flash, NVS, the card or
            the radio, and none of them changes what the UI renders. Turning
            this off removes the commands but keeps the boot log line and the
            report builder, so a release build can still be measured.

    config LW_DIAG_PERIODIC_LOG
        bool "Periodic heap line (rate limited to 30 s, off by default)"
        default n
        help
            Emits one diagnostics line every 30 seconds, and only when the free
            heap moved by at least 8 KiB. Off by default: even at 30 s the line
            is long enough to disturb a serial capture, and a board test should
            ask for the numbers instead of being handed a stream.

    config LW_DIAG_MAX_TEXT
        int "Maximum bytes for one diagnostics text block"
        range 512 4096
        default 1536
        help
            Buffer used by the diag command. The full block is about 700 bytes;
            the default leaves room for long card paths without a heap
            allocation on the console task.

    config LW_FAULT_INJECT
        bool "Diagnostic E: compile in the fault injection points"
        default n
        help
            Links lw_fault.c and arms the injection points that the storage,
            cache, asset and mount paths already check. With this off, every
            lw_fault_should_fail() call site compiles away and the code is byte
            identical to a build that never had the feature. When it is on, the
            read-only console grows a `fault` command that can arm a point, so
            the degradation paths can be exercised on the real board instead of
            only on the build machine. Never ship a build with this on: an
            armed point makes the firmware fail on purpose.

endmenu
```
